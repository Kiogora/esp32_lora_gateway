## esp32_port/components/iperf/Kconfig
```kconfig
menu "**WIFI AP configuration**"

config AP_SSID
    string "WIFI AP SSID"
	default "\"EED Sky\""
	help
		SSID of the Wifi access point.

config AP_PASSPHRASE
    string "WIFI AP PASSPHRASE"
	default "\"20150815\""
	help
		passphrase of the Wifi access point.

endmenu
```

## esp32_port/components/quectel_gsm/Kconfig
```kconfig
menu "**GSM PPPoS configuration**"

config GSM_DEBUG
    bool "Enable GSM debugging"
    default y
    help
        Show GSM debug messages

config GSM_TX
    int "UART Output to GSM Module"
    default 21
    range 1 30
    help
	UART Tx pin, connected to GSM Module Rx pin.

config GSM_RX
    int "UART Input from GSM Module"
    default 31
    range 1 38
    help
	UART Rx pin, connected to GSM Module Tx pin.

config GSM_PWR_KEY
    int "Power key pin output"
    default 16
    range 1 38
    help
	PWR KEY pin, connected to GSM Module pwr key.

config GSM_BDRATE
    int "UART Baud rate"
    default 115200
    help
	UART baudrate to comunicate with GSM module


config GSM_INTERNET_USER
    string "Internet User"
	default ""
	help
		Network provider internet user.

config GSM_INTERNET_PASSWORD
    string "Internet password"
	default ""
	help
		Network provider internet password
		
config GSM_APN
    string "Internet APN"
    default "providerAPN"
    help
       Network provider's APN for internet access

endmenu
```

## firmware/components/gsm/Kconfig
```kconfig
menu "GSM PIN AND UART PERIPHERAL SELECTION"

config GSM_TX
    int "UART Output to GSM Module"
    default 17
    range 1 38
    help
	UART TX pin, connected to GSM Module RX pin.

config GSM_RX
    int "UART Input from GSM Module"
    default 14
    range 1 38
    help
	UART RX pin, connected to GSM Module TX pin.

config GSM_PWR_KEY
    int "Power key pin output"
    default 18
    range 1 38
    help
	PWR KEY pin, connected to GSM Module pwr key.

config GSM_UART_NUM
    int "GSM UART peripheral number"
    default 1
    range 1 2
    help
	UART peripheral in use by the GPS. Should be 1 or 2. 0 is used for USB/UART download.

endmenu

menu "GSM PPPoS CONFIGURATION"

config GSM_DEBUG
    bool "Enable GSM debugging"
    default y
    help
        Show GSM debug messages

config GSM_BDRATE
    int "UART Baud rate"
    default 115200
    help
	UART baudrate to comunicate with GSM module


config GSM_INTERNET_USER
    string "Internet User"
	default "saf"
	help
		Network provider internet user.

config GSM_INTERNET_PASSWORD
    string "Internet password"
	default "data"
	help
		Network provider internet password
		
config GSM_APN
    string "Internet APN"
    default "safaricom"
    help
       Network provider's APN for internet access

endmenu
```

## firmware/components/loragw_gps/Kconfig
```kconfig
menu "GPS PIN AND PERIPHERAL SELECTION"

config GPS_TX_PIN
    int "UART Output pin to GPS Module"
    default 36
    range 1 38
    help
	UART TX pin, connected to GPS Module RX pin.

config GPS_RX_PIN
    int "UART Input pin from GPS Module"
    default 15
    range 1 38
    help
	UART RX pin, connected to GPS Module TX pin.

config GPS_UART_NUM
    int "GPS UART peripheral number"
        default 2
    range 1 2
    help
	UART peripheral in use by the GPS. Should be 1 or 2. 0 is used for USB/UART download.

endmenu
```

## firmware/components/loragw_spi/Kconfig
```kconfig
menu " LORA CONCENTRATOR PIN CONFIGURATION"

config LORA_MISO_PIN
    int "LoRa concentrator MISO pin"
    default 33
    range 1 38
    help
	LoRa concentrator MISO pin.

config LORA_MOSI_PIN
    int "LoRa concentrator MOSI pin"
    default 32
    range 1 38
    help
	LoRa concentrator MOSI pin.

config LORA_CS_PIN
    int "LoRa concentrator CSN pin"
    default 4
    range 1 38
    help
	LoRa concentrator CSN pin.

config LORA_CLK_PIN
    int "LoRa concentrator SCK pin"
    default 2
    range 1 38
    help
	LoRa concentrator SCK pin.

config LORA_RESET_PIN
    int "LoRa concentrator RESET pin"
    default 5
    range 1 38
    help
	LoRa concentrator SX1301 RESET pin.

endmenu
```
